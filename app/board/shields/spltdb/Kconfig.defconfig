## app/board/shields/spltdb/Kconfig.defconfig
```kconfig
if SHIELD_SPLITDB_LEFT

config ZMK_KEYBOARD_NAME
    default "splitdb"

config ZMK_SPLIT_ROLE_CENTRAL
    default y

endif

if SHIELD_SPLITDB_LEFT || SHIELD_SPLITDB_RIGHT

config ZMK_SPLIT
    default y

endif
```

## boards/shields/SPLITDB/Kconfig.shield
```kconfig
config SHIELD_SPLITDB_LEFT
    def_bool $(shields_list_contains,splitdb_left)

config SHIELD_SPLITDB_RIGHT
    def_bool $(shields_list_contains,splitdb_right)
```
